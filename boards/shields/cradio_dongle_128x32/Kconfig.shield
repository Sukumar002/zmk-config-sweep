## boards/shields/cradio_dongle_128x32/Kconfig.shield
```kconfig
# SPDX-License-Identifier: MIT

config SHIELD_CRADIO_DONGLE_128X32
    def_bool $(shields_list_contains,cradio_dongle_128x32)
```

## boards/shields/cradio_dongle_128x64/Kconfig.shield
```kconfig
# SPDX-License-Identifier: MIT

config SHIELD_CRADIO_DONGLE_128X64
    def_bool $(shields_list_contains,cradio_dongle_128x64)
```
